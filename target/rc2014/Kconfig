## target/rc2014/Kconfig
```kconfig
menu "Zeal 8-bit Computer configuration"
    config TARGET_HAS_MMU
        bool
        default n

    config KERNEL_TARGET_HAS_MMU
        bool "Enable MMU support in the kernel"
        default n

endmenu
```
